//#include <zmk-config-squishy48/boards/shields/squishy48.dtsi>

&right_encoder {
    status = "okay";
};
&default_transform { // Offset of 6 because the left side has 6 columns
    col-offset = <6>;
};