## boards/shields/squishy48/Kconfig.shield
```kconfig
# No whitespace after the comma or in your part name!
config SHIELD_SQUISHY48_LEFT
    def_bool $(shields_list_contains,squishy48_left)

# No whitespace after the comma or in your part name!
config SHIELD_SQUISHY48_RIGHT
    def_bool $(shields_list_contains,squishy48_right)
```
